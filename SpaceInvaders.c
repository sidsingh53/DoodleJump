// DoodleJump.c
// Runs on LM4F120/TM4C123
// Jonathan Valvano and Daniel Valvano
// This is a starter project for the EE319K Lab 10

// Last Modified: 11/21/2017 
// http://www.spaceinvaders.de/
// sounds at http://www.classicgaming.cc/classics/spaceinvaders/sounds.php
// http://www.classicgaming.cc/classics/spaceinvaders/playguide.php
/* This example accompanies the books
   "Embedded Systems: Real Time Interfacing to Arm Cortex M Microcontrollers",
   ISBN: 978-1463590154, Jonathan Valvano, copyright (c) 2017

   "Embedded Systems: Introduction to Arm Cortex M Microcontrollers",
   ISBN: 978-1469998749, Jonathan Valvano, copyright (c) 2017

 Copyright 2017 by Jonathan W. Valvano, valvano@mail.utexas.edu
    You may use, edit, run or distribute this file
    as long as the above copyright notice remains
 THIS SOFTWARE IS PROVIDED "AS IS".  NO WARRANTIES, WHETHER EXPRESS, IMPLIED
 OR STATUTORY, INCLUDING, BUT NOT LIMITED TO, IMPLIED WARRANTIES OF
 MERCHANTABILITY AND FITNESS FOR A PARTICULAR PURPOSE APPLY TO THIS SOFTWARE.
 VALVANO SHALL NOT, IN ANY CIRCUMSTANCES, BE LIABLE FOR SPECIAL, INCIDENTAL,
 OR CONSEQUENTIAL DAMAGES, FOR ANY REASON WHATSOEVER.
 For more information about my classes, my research, and my books, see
 http://users.ece.utexas.edu/~valvano/
 */
// ******* Possible Hardware I/O connections*******************
// Slide pot pin 1 connected to ground
// Slide pot pin 2 connected to PE2/AIN1
// Slide pot pin 3 connected to +3.3V 
// fire button connected to PE0
// special weapon fire button connected to PE1
// 8*R resistor DAC bit 0 on PB0 (least significant bit)
// 4*R resistor DAC bit 1 on PB1
// 2*R resistor DAC bit 2 on PB2
// 1*R resistor DAC bit 3 on PB3 (most significant bit)
// LED on PB4
// LED on PB5

// Backlight (pin 10) connected to +3.3 V
// MISO (pin 9) unconnected
// SCK (pin 8) connected to PA2 (SSI0Clk)
// MOSI (pin 7) connected to PA5 (SSI0Tx)
// TFT_CS (pin 6) connected to PA3 (SSI0Fss)
// CARD_CS (pin 5) unconnected
// Data/Command (pin 4) connected to PA6 (GPIO), high for data, low for command
// RESET (pin 3) connected to PA7 (GPIO)
// VCC (pin 2) connected to +3.3 V
// Gnd (pin 1) connected to ground

#include <stdint.h>
#include "tm4c123gh6pm.h"
#include "ST7735.h"
#include "Random.h"
#include "PLL.h"
#include "ADC.h"


void DisableInterrupts(void); // Disable interrupts
void EnableInterrupts(void);  // Enable interrupts
void Delay100ms(uint32_t count); // time delay in 0.1 seconds
void Fall(void);
void MoveBullet(void);
void KillMonster(void);
uint32_t ADCMail, bulletX, bulletFlag, randomMonster, moveBullet, checkForHit = 0;
int32_t bulletY, noBullets = 1;
uint8_t	 ADCStatus = 0, killTheMonster = 0;
uint8_t doodleX, stillFalling, springX, springY;
uint32_t slidePotX, randomX, randomY;
uint32_t i, springFlag = 0, hitSpring;
uint32_t check, monsterAlive = 0;
uint32_t score = 0;
uint8_t t = 0;
int spriteX = 50;
int spriteY = 90;
int platformX = 52;
int platformY = 149;
uint8_t life = 1;
uint32_t outData;
uint8_t jumpCount = 0;
uint8_t hitPlatform = 0;

uint32_t Convert(uint32_t input){
	uint32_t solution = 0;
	solution = (256*input)/10000;
  return (solution);
}

void	PortF_Init(){
	uint8_t nothing = 0;
	SYSCTL_RCGCGPIO_R |= 0x30;
	nothing++;
	nothing++;
	nothing++;
	nothing++;
	GPIO_PORTF_LOCK_R = 0x4C4F434B; //unlock
	//GPIO_PORTE_CR_R |= 0x1F;
	GPIO_PORTE_DIR_R	&= 0xFD;
	GPIO_PORTF_PUR_R	|= 0x11;
	GPIO_PORTE_DEN_R	|= 0x02;
}

void PortE_Init(){
	SYSCTL_RCGCGPIO_R |= 0x11;
	GPIO_PORTE_DIR_R &= ~0x11;
	GPIO_PORTE_AFSEL_R &= ~0x10;
	GPIO_PORTE_DEN_R |= 0x11;
	GPIO_PORTE_AMSEL_R &= ~0x10;
	GPIO_PORTE_PCTL_R &= ~0x000F0000;
	GPIO_PORTE_IS_R &= ~0x10;
	GPIO_PORTE_IBE_R &= ~0x10;
	GPIO_PORTE_IEV_R |= 0x10;
	GPIO_PORTE_ICR_R = 0x10;
	GPIO_PORTE_IM_R |= 0x10;
	NVIC_PRI1_R = (NVIC_PRI1_R & 0xFFFFFF00) | 0x00000040;
	NVIC_EN0_R = 0x00000014;
	EnableInterrupts();
}
	

// *************************** Images ***************************
typedef enum {live, dead} state_t;

struct bullet{
	int x;
	int y;
	state_t status;
};

struct platform{
	int x;
	int y;
};
typedef struct platform platform_t;
platform_t pf[8];

struct character{
	int	x;
	int	y;
	int w;
	int h;
	const unsigned short *name;
	state_t status;
};

struct Bullet{
	int x;
	int y;
	state_t status;
};
typedef struct Bullet bullet_t;
bullet_t bullet[5];

const unsigned short TitleScreen[] = {
 0xFFFF, 0xFFFF, 0xFFFF, 0xFFFF, 0xFFFF, 0xFFFF, 0xFFFF, 0xFFFF, 0xFFFF, 0xFFFF, 0xFFFF, 0xFFFF, 0xFFFF, 0xFFFF, 0xFFFF, 0xFFFF,
 0xFFFF, 0xFFFF, 0xFFFF, 0xFFFF, 0xFFFF, 0xFFFF, 0xFFFF, 0xFFFF, 0xFFFF, 0xFFFF, 0xFFFF, 0xFFFF, 0xFFFF, 0xFFFF, 0xFFFF, 0xFFFF,
 0xFFFF, 0xFFFF, 0xFFFF, 0xFFFF, 0xFFFF, 0xFFFF, 0xFFFF, 0xFFFF, 0xFFFF, 0xFFFF, 0xFFFF, 0xFFFF, 0xFFFF, 0xFFFF, 0xFFFF, 0xFFFF,
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 0xFFFF, 0xFFFF, 0xFFFF, 0xFFFF, 0xFFFF, 0xFFFF, 0xFFFF, 0xFFFF, 0xFFFF,
};
	
// image of the doodle
const unsigned short Doodle[] = {
 0xFFFF, 0xFFFF, 0xFFFF, 0xFFFF, 0xFFFF, 0xFFFF, 0xFFFF, 0xFFFF, 0xFFFF, 0xFFFF, 0xFFFF, 0xFFFF, 0xFFFF, 0xFFFF, 0xFFFF, 0xFFFF,
 0xFFFF, 0xFFFF, 0xFFFF, 0xFFFF, 0x0000, 0x0000, 0xFFFF, 0x0000, 0x0000, 0xFFFF, 0x0000, 0x0000, 0xFFFF, 0x0000, 0x0000, 0xFFFF,
 0xFFFF, 0xFFFF, 0xFFFF, 0xFFFF, 0xFFFF, 0x0000, 0xFFFF, 0xFFFF, 0x0000, 0xFFFF, 0xFFFF, 0x0000, 0xFFFF, 0xFFFF, 0x0000, 0xFFFF,
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 0xFFFF, 0xFFFF, 0xFFFF, 0xFFFF, 0xFFFF, 0xFFFF, 0xFFFF, 0xFFFF, 0xFFFF, 0xFFFF, 0xFFFF, 0xFFFF, 0xFFFF, 0xFFFF, 0xFFFF, 0xFFFF,
};

const unsigned short Monster1[] = {
 0xFFFF, 0xFFFF, 0xFFFF, 0xFFFF, 0xFFFF, 0xFFFF, 0xFFFF, 0xFFFF, 0xFFFF, 0xFFFF, 0xFFFF, 0xFFFF, 0xFFFF, 0xFFFF, 0xFFFF, 0xFFFF,
 0xFFFF, 0xFFFF, 0xFFFF, 0xFFFF, 0xFFFF, 0xFFFF, 0xFFFF, 0xFFFF, 0xFFFF, 0x0000, 0x0000, 0x0000, 0x0000, 0xFFFF, 0xFFFF, 0xFFFF,
 0xFFFF, 0xFFFF, 0xFFFF, 0xFFFF, 0xFFFF, 0xFFFF, 0xFFFF, 0xFFFF, 0xFFFF, 0xFFFF, 0xFFFF, 0xFFFF, 0xFFFF, 0xFFFF, 0xFFFF, 0xFFFF,
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 0xFFFF, 0xFFFF, 0xFFFF, 0xFFFF,
};

const unsigned short Monster2[] = {
 0xFFFF, 0xFFFF, 0xFFFF, 0xFFFF, 0xFFFF, 0xFFFF, 0xFFFF, 0xFFFF, 0xFFFF, 0xFFFF, 0xFFFF, 0xFFFF, 0xFFFF, 0xFFFF, 0xFFFF, 0xFFFF,
 0xFFFF, 0xFFFF, 0xFFFF, 0xFFFF, 0xFFFF, 0xFFFF, 0xFFFF, 0xFFFF, 0xFFFF, 0xFFFF, 0xFFFF, 0xFFFF, 0xFFFF, 0xFFFF, 0xFFFF, 0xFFFF,
 0xFFFF, 0xFFFF, 0xFFFF, 0xFFFF, 0xFFFF, 0xFFFF, 0xFFFF, 0xFFFF, 0xFFFF, 0xFFFF, 0xFFFF, 0xFFFF, 0xFFFF, 0xFFFF, 0xFFFF, 0xFFFF,
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 0xFFFF, 0xFFFF, 0xFFFF, 0xFFFF, 0xFFFF, 0xFFFF, 0xFFFF, 0xFFFF, 0xFFFF, 0xFFFF, 0xFFFF,
};

const unsigned short Monster3[] = {
 0xFFFF, 0xFFFF, 0xFFFF, 0xFFFF, 0xFFFF, 0xFFFF, 0xFFFF, 0xFFFF, 0xFFFF, 0xFFFF, 0xFFFF, 0xFFFF, 0xFFFF, 0xFFFF, 0xFFFF, 0xFFFF,
 0xFFFF, 0xFFFF, 0xFFFF, 0xFFFF, 0xFFFF, 0xFFFF, 0xFFFF, 0xFFFF, 0xFFFF, 0xFFFF, 0xFFFF, 0xFFFF, 0xFFFF, 0xFFFF, 0xFFFF, 0xFFFF,
 0xFFFF, 0xFFFF, 0xFFFF, 0xFFFF, 0xFFFF, 0xFFFF, 0xFFFF, 0xFFFF, 0xFFFF, 0xFFFF, 0xFFFF, 0xFFFF, 0xFFFF, 0xFFFF, 0xFFFF, 0xFFFF,
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 0xFFFF, 0xFFFF, 0xFFFF, 0xFFFF, 0xFFFF, 0xFFFF, 0xFFFF, 0xFFFF, 0xFFFF, 0xFFFF, 0xFFFF, 0xFFFF, 0xFFFF,
};

typedef struct character monsters;
monsters monster1 = {
	0,
	0,
	23,
	28,
	Monster1,
	dead
};

monsters monster2 = {
	0,
	0,
	31,
	37,
	Monster2,
	dead
};

monsters monster3 = {
	0,
	0,
	23,
	27,
	Monster3,
	dead
};

monsters *monsterArray[3] = {&monster1, &monster2, &monster3};

// width=32 x height=32
const unsigned short platform[] = {
 0xFFFF, 0xFFFF, 0xFFFF, 0xFFFF, 0xFFFF, 0xFFFF, 0xFFFF, 0xFFFF, 0xFFFF, 0xFFFF, 0xFFFF, 0xFFFF, 0xFFFF, 0xFFFF, 0xFFFF, 0xFFFF,
 0xFFFF, 0xFFFF, 0xFFFF, 0xFFFF, 0x15E5, 0x15E5, 0x15E5, 0x15E5, 0x15E5, 0x15E5, 0x15E5, 0x15E5, 0x15E5, 0x15E5, 0x15E5, 0x15E5,
 0x15E5, 0x15E5, 0x15E5, 0x15E5, 0x15E5, 0x15E5, 0x15E5, 0x15E5, 0x15E5, 0x15E5, 0x15E5, 0x15E5, 0x15E5, 0x15E5, 0x15E5, 0x15E5,
 0x15E5, 0x15E5, 0x15E5, 0x15E5, 0x15E5, 0x15E5, 0x15E5, 0x15E5, 0x15E5, 0x15E5, 0x15E5, 0x15E5, 0x15E5, 0x15E5, 0x15E5, 0x15E5,
 0x15E5, 0x15E5, 0x15E5, 0x15E5, 0x15E5, 0x15E5, 0x15E5, 0x15E5, 0x15E5, 0x15E5, 0x15E5, 0x15E5, 0x15E5, 0x15E5, 0x15E5, 0x15E5,
 0xFFFF, 0xFFFF, 0xFFFF, 0xFFFF, 0xFFFF, 0xFFFF, 0xFFFF, 0xFFFF, 0xFFFF, 0xFFFF, 0xFFFF, 0xFFFF, 0xFFFF, 0xFFFF, 0xFFFF, 0xFFFF,
 0xFFFF, 0xFFFF, 0xFFFF, 0xFFFF,
};

const unsigned short Bullet[] = {
 0xFFFF, 0xFFFF, 0xFFFF, 0xFFFF, 0xFFFF, 0x0000, 0x0000, 0xFFFF, 0xFFFF, 0x0000, 0x0000, 0xFFFF, 0xFFFF, 0xFFFF, 0xFFFF, 0xFFFF,
};

const unsigned short eraseBullet[] = {
	0xFFFF, 0xFFFF, 0xFFFF, 0xFFFF, 0xFFFF, 0xFFFF, 0xFFFF, 0xFFFF, 0xFFFF, 0xFFFF, 0xFFFF, 0xFFFF, 0xFFFF, 0xFFFF, 0xFFFF, 0xFFFF,
};

const unsigned short Spring[] = {
 0xFFFF, 0xFFFF, 0x0000, 0x0000, 0x0000, 0x0000, 0x0000, 0xFFFF, 0xFFFF, 0xFFFF, 0x0000, 0xFFFF, 0xFFFF, 0xFFFF, 0xFFFF, 0xFFFF,
 0xFFFF, 0xFFFF, 0xFFFF, 0xFFFF, 0xFFFF, 0xFFFF, 0x0000, 0x0000, 0xFFFF, 0xFFFF, 0xFFFF, 0xFFFF, 0x0000, 0x0000, 0xFFFF, 0xFFFF,
 0xFFFF, 0x0000, 0xFFFF, 0xFFFF, 0xFFFF, 0xFFFF, 0xFFFF, 0xFFFF, 0xFFFF, 0xFFFF, 0xFFFF, 0xFFFF, 0xFFFF, 0xFFFF, 0xFFFF, 0xFFFF,
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 0xFFFF, 0xFFFF, 0xFFFF, 0xFFFF, 0xFFFF,
};

void	SysTick_Init(void){
	NVIC_ST_CTRL_R = 0;			//disable the timer
	NVIC_ST_CURRENT_R = 0;	//initialize systick timer
	NVIC_ST_RELOAD_R = 2666667;		//set reload to 60 Hz
  NVIC_ST_CTRL_R |= 0x07;	//turn on interrupts and set bus clock and start
}

void	SysTick_Handler(){
	uint32_t handlerData;
	slidePotX = Convert(ADC_In());							//read the data from the adc
	//ST7735_DrawBitmap(slidePotX, spriteY, Doodle, 27, 23);
}

void GPIOPortE_Handler(void){
	GPIO_PORTE_ICR_R = 0x10;
	for(i=0;bullet[i].status == live;i++){
	}
	bullet[i].x = doodleX + 7;
	bullet[i].y = spriteY - 19;
	bullet[i].status = live;
	//ST7735_FillRect(bulletX, bulletY, 4, 4, 0);
	//
	Sound_Shoot();
	bulletFlag = 1;
}

void Jump(void){
	if(hitSpring == 0){
		Fall();
		if(stillFalling == 0){
			if(jumpCount < 25){
				spriteY--;
				jumpCount++;
				TIMER0_TAILR_R = TIMER0_TAILR_R + 75000;
			}
			if(jumpCount == 25){
				TIMER0_TAILR_R = 5000000;
				jumpCount = 0;	
			}
			if(jumpCount == 7){
				hitPlatform = 0;
			}
			if(jumpCount == 0){
				//TIMER0_TAILR_R = 1000000;
			}
			//TIMER0_TAILR_R = TIMER0_TAILR_R + 100000;
		}
		if(stillFalling == 1){
			if(TIMER0_TAILR_R > 1000000){
				//TIMER0_TAILR_R = TIMER0_TAILR_R - 100000;
			}
		}
	}
	if(hitSpring == 1){
		if(jumpCount < 159){
			spriteY--;
			jumpCount++;
		}
		if(jumpCount == 159){
			hitSpring = 0;
			jumpCount = 0;
			TIMER0_TAILR_R = 5000000;
		}
	}
}

void Fall(void){
	if(jumpCount == 0){
		if(springFlag == 1){
			if((spriteY + 2) == springY){
				if((doodleX + 14) >= springX){
					if((doodleX + 1) <= (springX + 9)){
						Sound_Jump();
						hitSpring = 1;
						TIMER0_TAILR_R = 500000;
						jumpCount = 0;
					}
				}
			}
		}
	}
	if(hitSpring == 0){
		if(jumpCount == 0){
			for(i=0;i<8;i++){
				if (spriteY <= pf[i].y - 4){
					if(spriteY >= pf[i].y - 6){
						if((doodleX + 14) >= pf[i].x){
							if((doodleX + 1) <= (pf[i].x +20)){
								Sound_Jump();
								hitPlatform = 1;
								TIMER0_TAILR_R = 750000;
							}
						}
					}
				}
			}
		}
		if(hitSpring == 0){
			if(jumpCount == 0){
				if(spriteY == (monsterArray[randomMonster]->y - monsterArray[randomMonster]->h + 1)){
					if((doodleX + 14) >= (monsterArray[randomMonster]->x + 1)){
						if((doodleX + 1) <= (monsterArray[randomMonster]->x + monsterArray[randomMonster]->w -1)){
							Sound_Jump();
							hitPlatform = 1;
							TIMER0_TAILR_R = 750000;
							monsterArray[randomMonster]->status = dead;
							monsterAlive = 0;
							KillMonster();
						}
					}
				}
			}
		}
		if(hitSpring == 0){
			if(jumpCount == 0){
				if(hitPlatform == 0){
					spriteY++;
					if(TIMER0_TAILR_R > 1000000){
						TIMER0_TAILR_R = TIMER0_TAILR_R - 400000;
					}
					stillFalling = 1;
				}
			}
			if(hitPlatform){
				stillFalling = 0;
			}
		}
	}
}

void ScrollScreen(){
	score++;
	if(springFlag == 1){
		springY++;
	}
	if(springFlag == 1){
		if((springY - 12) == 160){
			springFlag = 0;
		}
	}
	for(i=0;i<8;i++){
		pf[i].y++;
	}
	spriteY++;
	for(i=0;i<3;i++){
		if(monsterArray[randomMonster]->status == live){
			monsterAlive =1;
		}
	}
	if(monsterAlive == 0){
		if((score % (150 + (Random32() % 361))) == 0){
			randomMonster = Random32() % 3;
			monsterArray[randomMonster]->x = Random32() % (126 - monsterArray[randomMonster]->w);
			monsterArray[randomMonster]->y = monsterArray[randomMonster]->h;
			monsterArray[randomMonster]->status = live;
		}
	}
	if((monsterArray[randomMonster]->status) == live){
		if((monsterArray[randomMonster]->y - monsterArray[randomMonster]->h) < 159){
			monsterArray[randomMonster]->y++;
		}
		if((monsterArray[randomMonster]->y - monsterArray[randomMonster]->h) >= 159){
			monsterArray[randomMonster]->status = dead;
			monsterAlive = 0;
		}
		ST7735_DrawBitmap(monsterArray[randomMonster]->x, monsterArray[randomMonster]->y, monsterArray[randomMonster]->name, monsterArray[randomMonster]->w, monsterArray[randomMonster]->h);
	}
	for(i=0;i<8;i++){
		ST7735_DrawBitmap(pf[i].x, pf[i].y, platform, 20, 5);
	}
	ST7735_DrawBitmap(doodleX, spriteY, Doodle, 16, 19);
}

void NewPlatform(){
	ST7735_DrawBitmap(pf[i].x, pf[i].y, platform, 20, 5);
	pf[i].x = Random32() % 105;
	pf[i].y = 20;
	ST7735_DrawBitmap(pf[i].x, pf[i].y, platform, 20, 5);
	if((score % 95) == 0){
		springX = pf[i].x;
		springY = pf[i].y - 4;
		ST7735_DrawBitmap(springX, springY, Spring, 9, 13);
		springFlag = 1;
	}
}

void MoveBullet(){
	for(i=0;bullet[i].status==live;i++){
		bullet[i].y--;
	}
	for(i=0;bullet[i].status==live;i++){
		if(bullet[i].y == 0){
			ST7735_DrawBitmap(bullet[i].x, bullet[i].y, eraseBullet, 4, 4);
			bullet[i].status = dead;
		}
	}
	for(i=0;i<5;i++){
		if(bullet[i].status == live){
			noBullets = 0;
		}
	}
	if(noBullets == 1){
		TIMER1_CTL_R = 0x00000000;
	}
	for(i=0;bullet[i].status == live;i++){
		if(bullet[i].y > 0){
			moveBullet = 1;
		}
	}
	for(i=0;i<3;i++){
		if(monsterArray[i]->status == live){
			checkForHit = 1;
		}
	}
	for(i=0;bullet[i].status == live;i++){
		if(((bullet[i].y - 3) == (monsterArray[randomMonster]->y - 1)) & ((bullet[i].x + 2) >= (monsterArray[randomMonster]->x + 1)) & ((bullet[i].x + 2) <= (monsterArray[randomMonster]->x + (monsterArray[randomMonster]->w + 1)))){
			KillMonster();
			bullet[i].status = dead;
		}
	}
}

void KillMonster(void){
	//TIMER1_CTL_R = 0x00000000;
	Sound_MonsterDie();
	killTheMonster = 1;
	monsterArray[randomMonster]->status = dead;
	monsterAlive = 0;
}

// *************************** Capture image dimensions out of BMP**********
int main(void){
	uint8_t n = 0;
  PLL_Init(Bus80MHz);       // Bus clock is 80 MHz 
	ADC_Init();
	Sound_Init();
  Random_Init(ADC_In());
  Output_Init();
	PortF_Init();
	Random_Init(ADC_In());
  ST7735_FillScreen(0xFFFF);            // set screen to white
	//ST7735_DrawBitmap(50, 50, Doodle, 27,23);
	ST7735_DrawBitmap(24, 66, TitleScreen, 81, 57);
	ST7735_SetCursor(2, 8);
  ST7735_OutString("Push right button");
	ST7735_SetCursor(6, 9);
	ST7735_OutString("for next");
	ST7735_SetCursor(2, 11);
  ST7735_OutString("Push left button");
	ST7735_SetCursor(6, 12);
	ST7735_OutString("to shoot");
	ST7735_SetCursor(2, 14);
  ST7735_OutString("Use slider to move");
	while((GPIO_PORTE_DATA_R & 0x02) != 0){
	} //check for press
	while((GPIO_PORTE_DATA_R & 0x02) != 2){
	} //check for release
	ST7735_FillScreen(0xFFFF);
	ST7735_DrawBitmap(24, 66, TitleScreen, 81, 57);
	ST7735_SetCursor(4, 8);
	ST7735_OutString("You can jump");
	ST7735_SetCursor(5, 9);
	ST7735_OutString("on monsters");
	ST7735_SetCursor(2, 11);
	ST7735_OutString("Push right button");
	ST7735_SetCursor(6, 12);
	ST7735_OutString("to start");
	while((GPIO_PORTE_DATA_R & 0x02) != 0){
	} //check for press
	while((GPIO_PORTE_DATA_R & 0x02) != 2){
	} //check for release
	PortE_Init();
	ST7735_FillScreen(0xFFFF);
	for(i=0;i<5;i++){
		bullet[i].status = dead;
	}
  for(i=0;i<8;i++){
		pf[i].x = Random32() % 105;
		pf[i].y = (i * 20) + 20;
		ST7735_DrawBitmap(pf[i].x, pf[i].y, platform, 20, 5);
	}
		
	//ST7735_DrawBitmap(30, 50, Monster1, 23, 28);
	//ST7735_DrawBitmap(70, 50, Monster2, 31, 37);
	//ST7735_DrawBitmap(50, 90, Monster3, 23, 27);
	slidePotX = Convert(ADC_In());
	ST7735_DrawBitmap(doodleX, spriteY, Doodle, 16, 19); // doodle begin position
	SysTick_Init();
	Timer0_Init(Jump, 5000000);
  while(1){	
		if(doodleX < slidePotX){
			doodleX++;
		}
		if(doodleX > slidePotX){
			doodleX--;
		}
		if(((doodleX + 15) == (monsterArray[randomMonster]->x + 1)) | ((doodleX + 1) == (monsterArray[randomMonster]->x + monsterArray[randomMonster]->w - 1))){
			if((((spriteY - 18) <= (monsterArray[randomMonster]->y - 1)) & ((spriteY - 18) >= (monsterArray[randomMonster]->y - monsterArray[randomMonster]->h + 1))) | (((spriteY - 1) <=  (monsterArray[randomMonster]->y - 1)) & ((spriteY - 1) >= (monsterArray[randomMonster]->y - monsterArray[randomMonster]->h + 1)))){
				endGame();
			}
		}
		if((spriteY - 18) == (monsterArray[randomMonster]->y - 1)){
			if((((doodleX + 1) >= (monsterArray[randomMonster]->x + 1)) & ((doodleX + 1) <= (monsterArray[randomMonster]->x + monsterArray[randomMonster]->w - 1))) | (((doodleX + 15) >= (monsterArray[randomMonster]->x + 1)) & ((doodleX + 15) <= (monsterArray[randomMonster]->x + monsterArray[randomMonster]->w - 1)))){
				endGame();
			}
		}
		//if((spriteY + 15) == (monsterArray[randomMonster]->y -1))
		ST7735_DrawBitmap(doodleX, spriteY, Doodle, 16, 19);
		ST7735_SetCursor(16, 1);
		LCD_OutDec(score);
		for(i=0;i<8;i++){
			ST7735_DrawBitmap(pf[i].x, pf[i].y, platform, 20, 5);
		}
		if(springFlag == 1){
			ST7735_DrawBitmap(springX, springY, Spring, 9, 13);
		}
		if(spriteY >= 159)
		{
			endGame();
		}
		if(spriteY <= 120){
			ScrollScreen();
		}
		for(i=0;i<8;i++){
			if((pf[i].y - 5) > 159){
				NewPlatform();
			}
		}
		if(bulletFlag == 1){
			ST7735_DrawBitmap(bulletX, bulletY, Bullet, 4, 4);
			Timer1_Init(MoveBullet, 750000);
			bulletFlag = 0;
		}
		if(moveBullet == 1){
			for(i=0;bullet[i].status == live;i++){
				ST7735_DrawBitmap(bullet[i].x, bullet[i].y, Bullet, 4, 4);
			}
			moveBullet = 0;
		}
		if(killTheMonster == 1){
			ST7735_FillScreen(0xFFFF);
			for(i=0;i<8;i++){
				ST7735_DrawBitmap(pf[i].x, pf[i].y, platform, 20, 5);
			}
			ST7735_DrawBitmap(doodleX, spriteY, Doodle, 16, 19);	
			killTheMonster = 0;
	  }
	}
}

// You can use this timer only if you learn how it works

void Delay100ms(uint32_t count){uint32_t volatile time;
  while(count>0){
    time = 181810;  // 0.025sec at 80 MHz
    while(time){
	  	time--;
    }
    count--;
  }
}

int endGame(){
	NVIC_ST_CTRL_R = 0;
	Sound_Die();
	ST7735_FillScreen(0xFFFF);            // set screen to black
  ST7735_SetCursor(6, 4);
  ST7735_OutString("Nice Try");
	ST7735_SetCursor(4, 9);
  ST7735_OutString("Your score is");
	ST7735_SetCursor(8, 10);
  LCD_OutDec(score); // put variable for score instead of 1234
	while(1)
	{
	}
	return(1);
}
